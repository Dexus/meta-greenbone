## conf/distro/greenbone-gvmd.conf
```bitbake
require conf/distro/poky.conf

DISTRO = "greenbone-gvmd"
DISTRO_NAME = "Greenbone GVMD (Build by DeineAgentur UG based on poky yocto)"
DISTRO_VERSION = "1.0.0"
DISTRO_CODENAME = "daug-gvmd"

INHERIT += "extrausers"
EXTRA_USERS_PARAMS = "useradd -P gvm gvm; \
    usermod -p gvm root;"


# qt com rasp
#DISTRO_FEATURES:remove = "x11 wayland"
DISTRO_FEATURES ?= "acl ext2 ext4 ipv4 ipv6 largefile xattr vfat"
DISTRO_FEATURES:append = " virtualization"

IMAGE_FSTYPES ?= "ext4 tar.bz2 tar.xz jffs2 wic wic.bmap"
```

## conf/distro/marina.conf
```bitbake
require conf/distro/poky.conf

DISTRO = "marina"
DISTRO_NAME = "Marina"
DISTRO_VERSION = "1.0-${DATE}"
DISTRO_CODENAME = "master"
SDK_VENDOR = "-marinasdk"

MAINTAINER = "Scott Murray <scott.murray@konsulko.com>"

TARGET_VENDOR = "-marina"

TCLIBC = "glibc"

DISTRO_FEATURES = "acl ipv4 ipv6 largefile xattr"
DISTRO_FEATURES:append = " virtualization"

DISTRO_FEATURES:append = " systemd"
DISTRO_FEATURES_BACKFILL_CONSIDERED += "sysvinit"
VIRTUAL-RUNTIME_init_manager = "systemd"
VIRTUAL-RUNTIME_initscripts = ""
```

## conf/distro/schooner.conf
```bitbake
require conf/distro/poky.conf

DISTRO = "schooner"
DISTRO_NAME = "Schooner"
DISTRO_VERSION = "1.0-${DATE}"
DISTRO_CODENAME = "master"
SDK_VENDOR = "-schoonersdk"

MAINTAINER = "Scott Murray <scott.murray@konsulko.com>"

TARGET_VENDOR = "-schooner"

TCLIBC = "glibc"

DISTRO_FEATURES ?= "acl ipv4 ipv6 largefile xattr"
DISTRO_FEATURES:append = " virtualization"

VIRTUAL-RUNTIME_dev_manager ?= ""
VIRTUAL-RUNTIME_login_manager ?= ""
VIRTUAL-RUNTIME_init_manager ?= ""
VIRTUAL-RUNTIME_initscripts ?= ""
VIRTUAL-RUNTIME_keymaps ?= ""

PREFERRED_PROVIDER_virtual/kernel = "linux-dummy"
```

## conf/layer.conf
```bitbake
# We have a conf and classes directory, add to BBPATH
BBPATH .= ":${LAYERDIR}"

# We have recipes-* directories, add to BBFILES
BBFILES += "${LAYERDIR}/recipes-*/*/*.bb \
            ${LAYERDIR}/recipes-*/*/*.bbappend"

BBFILE_COLLECTIONS += "meta-greenbone"
BBFILE_PATTERN_meta-greenbone = "^${LAYERDIR}/"
BBFILE_PRIORITY_meta-greenbone = "100"

LAYERDEPENDS_meta-greenbone = "core"
LAYERSERIES_COMPAT_meta-greenbone = "kirkstone"
```

## conf/machine/containerx86-64.conf
```bitbake
require conf/machine/qemux86-64.conf

PREFERED_PROVIDER_virtual/kernel = "linux-dummy"

MACHINE_ESSENTIAL_EXTRA_RDEPENDS = ""
```
